## CMakeLists.txt
```
# Copyright (c) 2024 GP Orcullo
# SPDX-License-Identifier: Apache-2.0

cmake_minimum_required(VERSION 3.20)

set(BOARD qemu_cortex_m3)

find_package(Zephyr REQUIRED HINTS $ENV{ZEPHYR_BASE})
project(udynlink-app)

set(UDYNLINK_SCRIPT_DIR "${UDYNLINK_SOURCE_DIR}/../scripts")
set(gen_dir ${ZEPHYR_BINARY_DIR}/include/generated/)

add_subdirectory(hello_world)
add_subdirectory(hello_world_cpp)

target_compile_definitions(app PRIVATE UDYNLINK_SKIP_PROLOGUE)
target_sources(app PRIVATE src/main.c)

add_dependencies(app hello_world hello_world_cpp)
```

## west.yml
```
manifest:

  projects:
    - name: zephyr
      url: https://github.com/zephyrproject-rtos/zephyr
      revision: v3.5.0
      path: zephyr
      west-commands: scripts/west-commands.yml
      import:
        name-allowlist:
          - cmsis
          - hal_stm32

    - name: module-udynlink
      url: https://github.com/kinsamanka/udynlink
      revision: master
      path: modules/lib/udynlink

  self:
    path: udynlink-app
```

## prj.conf
```kconfig
CONFIG_LOG=y
CONFIG_LOG_MODE_IMMEDIATE=y
CONFIG_UDYNLINK=y
```

## src/main.c
```c
/*
 * Copyright (c) 2024 GP Orcullo
 * SPDX-License-Identifier: Apache-2.0
 */

#include <udynlink/udynlink.h>

#include <stdlib.h>
#include <string.h>
#include <zephyr/kernel.h>

__aligned(4)
#include "hello_world_module_data.h"

__aligned(4)
#include "hello_world_cpp_module_data.h"

uint32_t udynlink_external_resolve_symbol(const char *name) {
    if (!strcmp(name, "printf"))
        return (uint32_t)&printf;
    else
        return 0;
}

void udynlink_external_free(void *p) {
    free(p);
}

void *udynlink_external_malloc(size_t size) {
    return malloc(size);
}

void udynlink_external_vprintf(const char *s, va_list va) {
    vprintf(s, va);
}

int main(void) {
    udynlink_module_t mod;

    printk("\nZephyr udynlink Example Application\n\n");

    udynlink_set_debug_level(UDYNLINK_DEBUG_WARNING);

    if (!udynlink_load_module(&mod, hello_world_module_data, NULL, 0,
                              UDYNLINK_LOAD_MODE_XIP)) {
        udynlink_sym_t sym;

        if (udynlink_lookup_symbol(&mod, "test", &sym) != NULL) {

            /* load LOT address to R9 */
            register void * const mod_base __asm__("r9") = mod.p_ram;
            __asm__ volatile("\n\t" ::"r"(mod_base));

            printk("Running test1:\n");
            int (*p_func)(void) = (int (*)(void))sym.val;
            printk("Result %d\n\n", p_func());
        }
    }

    if (!udynlink_load_module(&mod, hello_world_cpp_module_data, NULL, 0,
                              UDYNLINK_LOAD_MODE_XIP)) {
        udynlink_sym_t sym;

        /* load LOT address to R9 */
        register void * const mod_base __asm__("r9") = mod.p_ram;
        __asm__ volatile("\n\t" ::"r"(mod_base));

        if (udynlink_lookup_symbol(&mod, "test2", &sym) != NULL) {
            printk("Running test2:\n");
            int (*p_func)(void) = (int (*)(void))sym.val;
            printk("Result %d\n\n", p_func());
        }

        if (udynlink_lookup_symbol(&mod, "test3", &sym) != NULL) {
            printk("Running test3:\n");
            int (*p_func)(int, int, int) = (int (*)(int, int, int))sym.val;
            printk("Result %d\n\n", p_func(1, 2, 3));
        }
    }
    return 0;
}
```
